#include "ssd1306.h"
#include "i2c.h"
#include <stdint.h>
#include <math.h>

// ASCII reference table
static const uint8_t FONTS[][5] = {
    {0x00,0x00,0x00,0x00,0x00},	// 0x20
    {0x00,0x00,0x2F,0x00,0x00},	// 0x21
    {0x00,0x03,0x00,0x03,0x00},	// 0x22
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    {0x00,0x3C,0x22,0x3C,0x00},	// 0x7F
};

uint8_t framebuffer[1024]; // Pixel storage before screen refresh

void SSD1306_SendCommand(uint8_t cmd) {
	I2C_Start();
	I2C_WriteAddress(0x3C, 0);
	I2C_WriteByte(0x00); // Write to command register
	I2C_WriteByte(cmd); // Write command
	I2C_Stop();
}

void SSD1306_SendData(uint8_t data) {
	I2C_Start();
	I2C_WriteAddress(0x3C, 0);
	I2C_WriteByte(0x40); // Write to data register
	I2C_WriteByte(data); // Write data
	I2C_Stop();
}

void SSD1306_Init(void) {
	// Set MUX ratio
	SSD1306_SendCommand(0xA8);
	SSD1306_SendCommand(0x3F);

	// Set display offset
	SSD1306_SendCommand(0xD3);
	SSD1306_SendCommand(0x00);

	// Set display start line
	SSD1306_SendCommand(0x40);

	// Set segment re-map
	SSD1306_SendCommand(0xA1);

	// Set COM output scan direction
	SSD1306_SendCommand(0xC8);

	// Set COM pins hardware configuration
	SSD1306_SendCommand(0xDA);
	SSD1306_SendCommand(0x12);

	// Set contrast control
	SSD1306_SendCommand(0x81);
	SSD1306_SendCommand(0x7F);

	// Disable entire display on
	SSD1306_SendCommand(0xA4);

	// Set normal display
	SSD1306_SendCommand(0xA6);

	// Set oscillation frequency
	SSD1306_SendCommand(0xD5);
	SSD1306_SendCommand(0x80);

	// Enable charge pump regulator
	SSD1306_SendCommand(0x8D);
	SSD1306_SendCommand(0x14);

	// Display on
	SSD1306_SendCommand(0xAF);
}

void SSD1306_SetPixel(uint8_t x, uint8_t y) {
	if(x > 128) x = 128;
	if(y > 64) y = 64;
	uint16_t byte = ((y / 8) * 128) + x; // Calculate byte location
	uint16_t bitOffset = y % 8; // Calculate bit location in byte
	framebuffer[byte] |= (0x1 << bitOffset); // Set bit in specified byte
}

void SSD1306_Refresh() {
	// Set addressing mode to horizontal
	SSD1306_SendCommand(0x20);
	SSD1306_SendCommand(0x00);

	// Set column address bounds 0-127
	SSD1306_SendCommand(0x21);
	SSD1306_SendCommand(0x00);
	SSD1306_SendCommand(0x7F);

	// Set page address bounds 0-7
	SSD1306_SendCommand(0x22);
	SSD1306_SendCommand(0x00);
	SSD1306_SendCommand(0x07);

	// Send data to screen
	for(int i = 0; i < 1024; i++) {
		SSD1306_SendData(framebuffer[i]);
	}
}

void SSD1306_Clear() {
	// Set all bytes to 0
	for(int i = 0; i < 1024; i++) {
		framebuffer[i] = 0;
	}
}

void SSD1306_DrawChar(char c, uint8_t x, uint8_t y) {
	const uint8_t *character = FONTS[c - 0x20]; // Set ASCII binary for character c input

	// Loop over each ASCII binary value
	for(int i = 0; i < 5; i++) {
		for(int j = 0; j < 8; j++) {
			if(0 < (character[i] & (0x1 << j))) {
				SSD1306_SetPixel(x + i, y + j); // Set pixel using simple bitmask
			}
		}
	}
}

void SSD1306_DrawString(char *str, uint8_t x, uint8_t y) {
	while(*str != '\0') {
		SSD1306_DrawChar(*str, x, y); // Draw character of string
		x += 6; // Increase x pixel offset by a character
		str++; // Advance in string buffer
	}
}
